#ifndef levels_h
#define levels_h

//0 = Ground
//1 = Water
//2 = Up-left ground
//3 = Down-left ground
//4 = Up-right ground
//5 = Down-right ground
//6 = Empty Tile
//7 = Enter
//8 = Void
//9 = Ice
//A = Magma
//B = Closed Chest
//C = Leaves
//D = Bricks
//E = Empty Tile (Temple)
//F = Shattered Ice

const uint8_t PROGMEM levels[72][48] = {
  //GROUND LEVELS [0 - 34]
  {0x88,0x88,0x00,0x00,0x08,0x00,
   0x88,0x88,0x80,0x70,0x88,0x80,
   0x88,0x88,0x80,0x66,0x88,0x88,
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   0x88,0x88,0x88,0x80,0x00,0x70},
  //TEMPLES [35 - 66]
  //TEMPLE 1 [35 - 38]
  {0xDD,0xDD,0xDD,0xDD,0xDD,0xDD,
   0xDD,0xDD,0xDD,0xDD,0xDD,0xDD,
   0xDD,0x66,0x66,0x66,0x66,0x66,
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   0xDD,0xDD,0xDD,0xDD,0xDD,0xDD},
  //TEMPLE 2 [39 - 42]
  {0xDD,0xDD,0xDD,0xDD,0xDD,0xDD,
   0xDD,0xDD,0xDD,0xDD,0xDD,0xDD,
   0xDD,0x11,0x11,0x66,0x66,0x61,
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   0xDD,0xDD,0xDD,0xDD,0xDD,0xDD},
  //TEMPLE 3 [43 - 46]
  {0xDD,0xDD,0xDD,0xDD,0xDD,0xDD,
   0xD6,0x66,0xC6,0x66,0x6C,0x6C,
   0xD6,0xCC,0xC6,0xCC,0x66,0x6C,
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   0x6C,0x66,0x66,0x66,0x6C,0xCD},
  //TEMPLE 4 [47 - 50]
  {},
  {},
  {},
  {},
  //TEMPLE 5 [51 - 54]
  {},
  {},
  {},
  {},
  //TEMPLE 6 [55 - 58]
  {},
  {},
  {},
  {},
  //TEMPLE 7 [59 - 62]
  {},
  {},
  {},
  {},
  //TEMPLE 8 [63 - 66]
  {},
  {},
  {},
  {},
  //SHOPS [67]
  {},
  //PRIZE ROOM [68 - 71]
  {},
  {},
  {},
  {}
};
uint8_t curLvl[48] = {
   0x00,0x07,0x56,0x66,0x30,0x00,
   0x05,0x66,0x66,0x66,0x63,0x00,
   0x56,0x66,0x66,0x66,0x66,0x30,
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   0x00,0x00,0x00,0x00,0x00,0x00
};

#define DOOR_NUM 11

//0 = x, 1 = y, 2 = Map

const uint8_t doorLoc[DOOR_NUM][3] = {
  //PRIZE ROOM DOORS [0 - 7]
  {7,6,71},
  {10,1,70},
  {1,6,68},
  {10,6,68},
  {10,3,69},
  //TEMPLE 8 DOORS [8 - 10]
};

bool unlocked[DOOR_NUM];

/*
 * SPECIAL THANKS TO Dreamer2345 for literally shaving 20% of program space to his method of shrinking 2 blocks into 
 * 1 8-bit address. Without his help, some of the features would not be possible!
 * Arduboy profile account: https://community.arduboy.com/u/dreamer2345/summary
*/

uint8_t getOffset(uint8_t x,uint8_t y){
  uint8_t ColCheck = ((x/2)+(y*6));
  if (ColCheck < 48) return ColCheck;
  else return 0;
}

uint8_t getBlock(uint8_t x,uint8_t y){
 if (x >= 12 || y >= 8){return 0;}
 uint8_t Block = 0;
 if (x % 2 == 0){
    Block = curLvl[getOffset(x,y)] >> 4;
 }else {
    Block = curLvl[getOffset(x,y)] & 0x0F;
 }
 return Block;
}

void shatterIce(Rect swRect) {
  for(uint8_t x = 0; x < 96; x++) {
    uint8_t blck = getBlock(x%12,x/12);
    if(blck == 9 or blck == 15) {
      Rect tileRect = Rect {x % 12 * 8, x / 12 * 8, 8, 8};
      if(arduboy.collide(swRect, tileRect)) {
        if(x % 2 == 0) {
          curLvl[x / 2] = (blck == 9 ? 0xF0 : 0x60) + getBlock((x+1)%12,x/12);
        }else{
          curLvl[x / 2] = (getBlock((x-1)%12,x/12) << 4) + (blck == 9 ? 0x0F : 0x06);
        }
      }
    }
  }
}

#endif
